## configs/fischertechnik_TXT_defconfig
```kconfig
BR2_arm=y
BR2_cortex_a8=y
BR2_ARM_FPU_NEON=y
BR2_ARM_INSTRUCTIONS_THUMB2=y
BR2_REPRODUCIBLE=y
BR2_PER_PACKAGE_DIRECTORIES=y
BR2_TOOLCHAIN_EXTERNAL=y
BR2_TARGET_OPTIMIZATION="-pipe"
BR2_TARGET_GENERIC_HOSTNAME="FT-txt"
BR2_TARGET_GENERIC_ISSUE="Welcome to FT-txt"
BR2_TARGET_GENERIC_PASSWD_SHA512=y
BR2_INIT_NONE=y
BR2_ROOTFS_DEVICE_CREATION_DYNAMIC_EUDEV=y
BR2_ROOTFS_MERGED_USR=y
# BR2_TARGET_ENABLE_ROOT_LOGIN is not set
BR2_SYSTEM_BIN_SH_BASH=y
BR2_TARGET_GENERIC_GETTY_PORT="ttyO0"
BR2_TARGET_GENERIC_GETTY_BAUDRATE_115200=y
BR2_TARGET_GENERIC_GETTY_TERM="linux"
# BR2_TARGET_GENERIC_REMOUNT_ROOTFS_RW is not set
BR2_ENABLE_LOCALE_WHITELIST="C en_US de de_AT de_DE de_CH fr es nl pt"
BR2_GENERATE_LOCALE="en_US de_DE fr_FR nl_NL"
BR2_SYSTEM_ENABLE_NLS=y
BR2_TARGET_TZ_INFO=y
BR2_TARGET_LOCALTIME="Europe/Berlin"
BR2_ROOTFS_OVERLAY="$(BR2_EXTERNAL_FTCOMMUNITY_TXT_PATH)/board/fischertechnik/TXT/rootfs"
BR2_PACKAGE_BUSYBOX_CONFIG="$(BR2_EXTERNAL_FTCOMMUNITY_TXT_PATH)/board/fischertechnik/TXT/busybox_defconfig"
BR2_PACKAGE_BUSYBOX_SHOW_OTHERS=y
BR2_PACKAGE_BZIP2=y
BR2_PACKAGE_DOSFSTOOLS=y
BR2_PACKAGE_DOSFSTOOLS_MKFS_FAT=y
BR2_PACKAGE_E2FSPROGS=y
BR2_PACKAGE_MMC_UTILS=y
BR2_PACKAGE_MTD=y
BR2_PACKAGE_MTD_MKFSUBIFS=y
BR2_PACKAGE_UNIONFS=y
BR2_PACKAGE_LIBERATION=y
BR2_PACKAGE_QT5=y
BR2_PACKAGE_QT5BASE_DEFAULT_QPA="linuxfb"
BR2_PACKAGE_QT5BASE_TSLIB=y
BR2_PACKAGE_QT_WEBKIT_KIOSK=y
BR2_PACKAGE_LINUX_FIRMWARE=y
BR2_PACKAGE_LINUX_FIRMWARE_RTL_81XX=y
BR2_PACKAGE_LINUX_FIRMWARE_TI_WL18XX=y
BR2_PACKAGE_AVRDUDE=y
BR2_PACKAGE_HWDATA=y
# BR2_PACKAGE_HWDATA_PCI_IDS is not set
BR2_PACKAGE_I2C_TOOLS=y
BR2_PACKAGE_KBD=y
BR2_PACKAGE_RNG_TOOLS=y
BR2_PACKAGE_TI_UIM=y
BR2_PACKAGE_TI_UTILS=y
BR2_PACKAGE_TRIGGERHAPPY=y
BR2_PACKAGE_USB_MODESWITCH_DATA=y
BR2_PACKAGE_USBMOUNT=y
BR2_PACKAGE_USBUTILS=y
BR2_PACKAGE_CA_CERTIFICATES=y
BR2_PACKAGE_LIBHID=y
BR2_PACKAGE_LIBCURL=y
BR2_PACKAGE_LIBCURL_CURL=y
BR2_PACKAGE_LINUX_PAM=y
BR2_PACKAGE_NCURSES_TARGET_PROGS=y
BR2_PACKAGE_AESPIPE=y
BR2_PACKAGE_CRDA=y
BR2_PACKAGE_GESFTPSERVER=y
BR2_PACKAGE_HOSTAPD=y
BR2_PACKAGE_HOSTAPD_EAP=y
BR2_PACKAGE_HOSTAPD_WPS=y
BR2_PACKAGE_IFTOP=y
# BR2_PACKAGE_IFUPDOWN_SCRIPTS is not set
BR2_PACKAGE_IW=y
BR2_PACKAGE_NET_TOOLS=y
BR2_PACKAGE_NETCAT=y
BR2_PACKAGE_OPENOBEX=y
BR2_PACKAGE_OPENSSH=y
BR2_PACKAGE_RSYNC=y
BR2_PACKAGE_WGET=y
BR2_PACKAGE_WIREGUARD_TOOLS=y
BR2_PACKAGE_WIRELESS_TOOLS=y
BR2_PACKAGE_WIRELESS_TOOLS_LIB=y
BR2_PACKAGE_WPA_SUPPLICANT=y
BR2_PACKAGE_WPA_SUPPLICANT_AP_SUPPORT=y
BR2_PACKAGE_WPA_SUPPLICANT_MESH_NETWORKING=y
BR2_PACKAGE_WPA_SUPPLICANT_AUTOSCAN=y
BR2_PACKAGE_WPA_SUPPLICANT_EAP=y
BR2_PACKAGE_WPA_SUPPLICANT_HOTSPOT=y
BR2_PACKAGE_WPA_SUPPLICANT_DEBUG_SYSLOG=y
BR2_PACKAGE_WPA_SUPPLICANT_WPS=y
BR2_PACKAGE_WPA_SUPPLICANT_WPA3=y
BR2_PACKAGE_WPA_SUPPLICANT_CLI=y
BR2_PACKAGE_WPA_SUPPLICANT_WPA_CLIENT_SO=y
BR2_PACKAGE_WPA_SUPPLICANT_PASSPHRASE=y
BR2_PACKAGE_BASH_COMPLETION=y
BR2_PACKAGE_FILE=y
BR2_PACKAGE_SCREEN=y
BR2_PACKAGE_SUDO=y
BR2_PACKAGE_TIME=y
BR2_PACKAGE_WHICH=y
BR2_PACKAGE_HTOP=y
BR2_PACKAGE_PROCPS_NG=y
BR2_PACKAGE_LESS=y
BR2_PACKAGE_NANO=y
BR2_TARGET_ROOTFS_SQUASHFS=y
BR2_TARGET_ROOTFS_SQUASHFS4_ZSTD=y
# BR2_TARGET_ROOTFS_TAR is not set
BR2_PACKAGE_ROBOHEART=y
```

## configs/fischertechnik_TXT_initramfs_defconfig
```kconfig
BR2_arm=y
BR2_cortex_a8=y
BR2_ARM_FPU_NEON=y
BR2_ARM_INSTRUCTIONS_THUMB2=y
BR2_REPRODUCIBLE=y
BR2_PER_PACKAGE_DIRECTORIES=y
BR2_TOOLCHAIN_EXTERNAL=y
BR2_TARGET_OPTIMIZATION="-pipe"
BR2_TARGET_GENERIC_HOSTNAME="FT-txt-initramfs"
BR2_TARGET_GENERIC_ISSUE="Welcome to FT-txt initramfs"
BR2_INIT_NONE=y
BR2_ROOTFS_MERGED_USR=y
# BR2_TARGET_ENABLE_ROOT_LOGIN is not set
BR2_TARGET_GENERIC_GETTY_PORT="ttyO0"
BR2_TARGET_GENERIC_GETTY_BAUDRATE_115200=y
BR2_TARGET_GENERIC_GETTY_TERM="linux"
BR2_ROOTFS_OVERLAY="$(BR2_EXTERNAL_FTCOMMUNITY_TXT_PATH)/board/fischertechnik/TXT/initramfs"
BR2_ROOTFS_POST_BUILD_SCRIPT="$(BR2_EXTERNAL_FTCOMMUNITY_TXT_PATH)/board/fischertechnik/TXT/post-build-initramfs.sh"
BR2_LINUX_KERNEL=y
BR2_LINUX_KERNEL_CUSTOM_VERSION=y
BR2_LINUX_KERNEL_CUSTOM_VERSION_VALUE="4.14.233"
BR2_LINUX_KERNEL_PATCH="$(BR2_EXTERNAL_FTCOMMUNITY_TXT_PATH)/board/fischertechnik/TXT/patches/linux"
BR2_LINUX_KERNEL_USE_CUSTOM_CONFIG=y
BR2_LINUX_KERNEL_CUSTOM_CONFIG_FILE="$(BR2_EXTERNAL_FTCOMMUNITY_TXT_PATH)/board/fischertechnik/TXT/tisdk_am335x-fischertechnik_txt_defconfig"
BR2_LINUX_KERNEL_UIMAGE=y
BR2_LINUX_KERNEL_ZSTD=y
BR2_LINUX_KERNEL_UIMAGE_LOADADDR="0x80008000"
BR2_LINUX_KERNEL_DTS_SUPPORT=y
BR2_LINUX_KERNEL_CUSTOM_DTS_PATH="$(BR2_EXTERNAL_FTCOMMUNITY_TXT_PATH)/board/fischertechnik/TXT/am335x-kno_txt.dts"
BR2_PACKAGE_BUSYBOX_CONFIG="$(BR2_EXTERNAL_FTCOMMUNITY_TXT_PATH)/board/fischertechnik/TXT/busybox_initramfs_defconfig"
BR2_PACKAGE_BUSYBOX_SHOW_OTHERS=y
# BR2_PACKAGE_IFUPDOWN_SCRIPTS is not set
BR2_TARGET_ROOTFS_CPIO_ZSTD=y
BR2_TARGET_ROOTFS_CPIO_UIMAGE=y
BR2_TARGET_ROOTFS_INITRAMFS=y
# BR2_TARGET_ROOTFS_TAR is not set
```

## configs/ftCommunity_txpi1_defconfig
```kconfig
BR2_arm=y
BR2_arm1176jzf_s=y
BR2_PER_PACKAGE_DIRECTORIES=y
BR2_PACKAGE_HOST_LINUX_HEADERS_CUSTOM_4_19=y
BR2_TOOLCHAIN_BUILDROOT_CXX=y
BR2_LINUX_KERNEL=y
BR2_LINUX_KERNEL_CUSTOM_TARBALL=y
BR2_LINUX_KERNEL_CUSTOM_TARBALL_LOCATION="$(call github,raspberrypi,linux,4f2a4cc501c428c940549f39d5562e60404ac4f7)/linux-4f2a4cc501c428c940549f39d5562e60404ac4f7.tar.gz"
BR2_LINUX_KERNEL_DEFCONFIG="bcmrpi"
BR2_LINUX_KERNEL_DTS_SUPPORT=y
BR2_LINUX_KERNEL_INTREE_DTS_NAME="bcm2708-rpi-b bcm2708-rpi-b-plus bcm2708-rpi-cm"
BR2_LINUX_KERNEL_NEEDS_HOST_OPENSSL=y
BR2_PACKAGE_RPI_FIRMWARE=y
# BR2_TARGET_ROOTFS_TAR is not set
BR2_PACKAGE_RPI_FIRMWARE_FIXES=y
BR2_TARGET_ROOTFS_TXTZIP=y
BR2_TARGET_ROOTFS_TXTZIP_CUSTOM_NAME=y
BR2_TARGET_ROOTFS_TXTZIP_CUSTOM_NAME_NAME="txpi"
BR2_TARGET_ROOTFS_TXTZIP_FILES="$(BR2_EXTERNAL_FTCOMMUNITY_TXT_PATH)/board/ftCommunity/txpi/1/output.conf"
```

## package/framebuffer-vncserver/Config.in
```kconfig
config BR2_PACKAGE_FRAMEBUFFER_VNCSERVER
  bool "framebuffer-vncserver"
    select BR2_PACKAGE_LIBVNCSERVER
```

## package/rpi-firmware-fixes/Config.in
```kconfig
config BR2_PACKAGE_RPI_FIRMWARE_FIXES
  bool "Raspberry Pi firmware fixes"
  depends on BR2_PACKAGE_RPI_FIRMWARE

if BR2_PACKAGE_RPI_FIRMWARE_FIXES
  config BR2_PACKAGE_RPI_FIRMWARE_FIXES_BT_UART
    bool "Fix bluetooth uart"
    default BR2_PACKAGE_RPI_BT_FIRMWARE

  config BR2_PACKAGE_RPI_FIRMWARE_FIXES_DISABLE_WARNINGS
    bool "Disable power warnings"
    default y

  if BR2_PACKAGE_RPI_FIRMWARE_FIXES_DISABLE_WARNINGS
    config BR2_PACKAGE_RPI_FIRMWARE_FIXES_DISABLE_WARNINGS_TURBO
      bool "Allow turbo on low voltage"
  endif

endif
```
